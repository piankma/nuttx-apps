## database/sqlite/Kconfig
```kconfig
#
# For a description of the syntax of this configuration file,
# see the file kconfig-language.txt in the NuttX tools repository.
#

config LIB_SQLITE
	bool "SQLITE library"
	depends on FS_LOCK_BUCKET_SIZE > 0
	default n

if LIB_SQLITE

config LIB_SQLITE_VERSION
	string "SQLITE version"
	default "3.45.1"

config LIB_SQLITE_YEAR
	string "SQLITE release year"
	default "2024"
	---help---
		The year of the version's release: sqlite.org keeps its
		amalgamations under it (www.sqlite.org/<year>/).  Used when
		there is no git checkout in sqlite/.

config LIB_SQLITE_SMALL
	bool "Leave out rarely used parts"
	default n
	---help---
		Build without loadable extensions, deprecated and shared-cache
		interfaces, JSON, WAL, UTF-16, memory-mapped I/O and the
		progress and trace callbacks, and keep temporary tables in
		memory.  Saves flash on small systems.

config UTILS_SQLITE
	tristate "SQLite cmd line tool"
	default n

config UTILS_SQLITE_STACKSIZE
	int "SQLite3 cmd line tool stack size"
	default 8192
	depends on UTILS_SQLITE

endif
```

## examples/gnss/Kconfig
```kconfig
#
# For a description of the syntax of this configuration file,
# see the file kconfig-language.txt in the NuttX tools repository.
#

config EXAMPLES_GNSS
	tristate "GNSS position command"
	default n
	depends on UORB && SENSORS_GNSS
	---help---
		A small command that powers the GNSS receiver through its uORB
		topics, reports the satellites in view while it waits and prints
		the position once there is a fix.  It can set the system clock from
		the fix.  Its lines fit a 40 column terminal.

if EXAMPLES_GNSS

config EXAMPLES_GNSS_PROGNAME
	string "Program name"
	default "gps"
	---help---
		This is the name of the program that will be used when the NSH ELF
		program is installed.

config EXAMPLES_GNSS_PRIORITY
	int "GNSS task priority"
	default 100

config EXAMPLES_GNSS_STACKSIZE
	int "GNSS stack size"
	default DEFAULT_TASK_STACKSIZE

endif
```

## examples/lora/Kconfig
```kconfig
#
# For a description of the syntax of this configuration file,
# see the file kconfig-language.txt in the NuttX tools repository.
#

config EXAMPLES_LORA
	tristate "LoRa send/receive command (SX126x)"
	default n
	depends on LPWAN_SX126X
	---help---
		A small command to send and receive LoRa packets through the SX126x
		driver, with the frequency, spreading factor, bandwidth, coding
		rate, power and sync word on the command line.

if EXAMPLES_LORA

config EXAMPLES_LORA_PROGNAME
	string "Program name"
	default "lora"
	---help---
		This is the name of the program that will be used when the NSH ELF
		program is installed.

config EXAMPLES_LORA_PRIORITY
	int "LoRa task priority"
	default 100

config EXAMPLES_LORA_STACKSIZE
	int "LoRa stack size"
	default DEFAULT_TASK_STACKSIZE

config EXAMPLES_LORA_DEVPATH
	string "SX126x device"
	default "/dev/lora0"

endif
```

## examples/modem/Kconfig
```kconfig
#
# For a description of the syntax of this configuration file,
# see the file kconfig-language.txt in the NuttX tools repository.
#

config EXAMPLES_MODEM
	tristate "Cellular modem command (AT commands, power, SMS)"
	default n
	depends on DEV_GPIO
	---help---
		A small command for a cellular modem on a serial port that speaks
		3GPP AT commands (27.007/27.005): power it up and down through two
		GPIO devices (supply and PWRKEY), send AT commands, show its
		identity, SIM, signal and network registration, send and read SMS,
		and pass the console through to it.  Written for the SIMCom
		A7682E on the LilyGo T-Deck Max.

if EXAMPLES_MODEM

config EXAMPLES_MODEM_PROGNAME
	string "Program name"
	default "modem"
	---help---
		This is the name of the program that will be used when the NSH ELF
		program is installed.

config EXAMPLES_MODEM_PRIORITY
	int "modem task priority"
	default 100

config EXAMPLES_MODEM_STACKSIZE
	int "modem stack size"
	default DEFAULT_TASK_STACKSIZE

config EXAMPLES_MODEM_TTY
	string "Modem serial port"
	default "/dev/ttyS1"

config EXAMPLES_MODEM_PWR
	string "GPIO device for the modem supply"
	default "/dev/modem_pwr"

config EXAMPLES_MODEM_PWRKEY
	string "GPIO device that presses PWRKEY"
	default "/dev/modem_pwrkey"
	---help---
		Writing 1 presses the key (pulls the modem's PWRKEY low).

endif
```
